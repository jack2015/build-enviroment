## meta-dream/conf/machine/dm800se.conf
```bitbake
#@TYPE: Machine
#@NAME: Dreambox DM800se
#@DESCRIPTION: Machine configuration for the Dreambox DM800se

MACHINE_NAME = "DM800SE"

FLASHSIZE = "64"

MACHINE_FEATURES += "nowifi dvb-c blindscan-dvbc colorlcd hdmicec libpassthrough usbconsole smallflash singlecore no-cl-svr dreamboxv1 ombv1 no-nmap HDMI SCART"

require conf/machine/include/dreambox-brcmnand.inc
require conf/machine/include/dreambox-nand-64mb.inc
require conf/machine/include/dreambox-part-64mb.inc
require conf/machine/include/dreambox-mips32el.inc

MACHINE_ESSENTIAL_EXTRA_RDEPENDS += "dm-bootsplash"

CHIPSET = "bcm7405"
SOC_FAMILY = "bcm7405"

PREFERRED_VERSION_samba = "3.6.25"
PREFERRED_VERSION_sdparm = "1.07"
PREFERRED_VERSION_tzdata = "2017b"

IMAGE_FSTYPES = "jffs2"
IMAGE_CLASSES += "image_types_nfi"

# Add "dreamboxv1" override for recipes
MACHINEOVERRIDES .= ":dreamboxv1"

HAVE_HDMI = "True"
HAVE_SCART = "True"
```

## meta-dream/conf/machine/dm920.conf
```bitbake
#@TYPE: Machine
#@NAME: Dreambox DM920
#@DESCRIPTION: Machine configuration for the Dreambox DM920

MACHINE_NAME = "DM920"
MTD_ROOTFS = "mmcblk0p2"
MTD_KERNEL = "mmcblk0p1"
KERNEL_FILE = "kernel.bin"
ROOTFS_FILE = "rootfs.tar.bz2"
MTD_BLACK  = "mmcblk0"
IMAGEDIR = "${MACHINE}"

FLASHSIZE = "8192"

PREFERRED_PROVIDER_virtual/egl ?= "libvc5dream"
PREFERRED_PROVIDER_virtual/libgles1 ?= "libvc5dream"
PREFERRED_PROVIDER_virtual/libgles2 ?= "libvc5dream"

PREFERRED_PROVIDER_virtual/libgl ?= "mesa-gl"
PREFERRED_PROVIDER_virtual/mesa ?= "mesa-gl"

MACHINE_FEATURES += "dvb-c blindscan-dvbc hdmicec ci dvd libpassthrough usbconsole colorlcd400 dreamboxv2 skins1080 recovery blindscan-tbs v3d ombv2 mmc emmc HDMI HDMI-IN-FHD"

CHIPSET = "bcm7252s"
SOC_FAMILY = "bcm7252s"

PREFERRED_VERSION_linux-dreambox = "3.14"

DISTRO_FEATURES_GFX_mipsel ?= " opengl"

PACKAGECONFIG_pn-glmark2 = "gles2"

PACKAGECONFIG_pn-cogl-1.0 = "egl-kms egl-null \
        ${@bb.utils.contains('DISTRO_FEATURES', 'opengl', 'gles2', '', d)}"

PACKAGECONFIG_pn-weston = "${@bb.utils.contains('DISTRO_FEATURES', 'opengl', 'gles', '', d)}"

DREAMBOX_IMAGE_SIZE ??= "1024"

PREFERRED_VERSION_gnupg ?= "1.4.7"

require conf/machine/include/dreambox-arm.inc

IMAGE_FSTYPES = "tar.bz2"
IMAGE_CLASSES += "image_types_tarbz2"
```
